
#include "Config.h"


/* Table Of CRC Values for high-order unsigned char */
const unsigned char auchCRCHi[] = {
0x00, 0xC1, 0x81, 0x40, 0x01, 0xC0, 0x80, 0x41, 0x01, 0xC0, 0x80, 0x41, 0x00, 0xC1, 0x81,
0x40, 0x01, 0xC0, 0x80, 0x41, 0x00, 0xC1, 0x81, 0x40, 0x00, 0xC1, 0x81, 0x40, 0x01, 0xC0,
0x80, 0x41, 0x01, 0xC0, 0x80, 0x41, 0x00, 0xC1, 0x81, 0x40, 0x00, 0xC1, 0x81, 0x40, 0x01,
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0x00, 0xC1, 0x81, 0x40, 0x01, 0xC0, 0x80, 0x41, 0x01, 0xC0, 0x80, 0x41, 0x00, 0xC1, 0x81,
0x40
};

/* Table of CRC values for low-order unsigned char    */
const unsigned char auchCRCLo[] = {
0x00, 0xC0, 0xC1, 0x01, 0xC3, 0x03, 0x02, 0xC2, 0xC6, 0x06, 0x07, 0xC7, 0x05, 0xC5, 0xC4,
0x04, 0xCC, 0x0C, 0x0D, 0xCD, 0x0F, 0xCF, 0xCE, 0x0E, 0x0A, 0xCA, 0xCB, 0x0B, 0xC9, 0x09,
0x08, 0xC8, 0xD8, 0x18, 0x19, 0xD9, 0x1B, 0xDB, 0xDA, 0x1A, 0x1E, 0xDE, 0xDF, 0x1F, 0xDD,
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0x44, 0x84, 0x85, 0x45, 0x87, 0x47, 0x46, 0x86, 0x82, 0x42, 0x43, 0x83, 0x41, 0x81, 0x80,
0x40
};



unsigned int Modbus_Port[16];						//16*5
unsigned int Modbus_ReadOnly_Var[32];	
unsigned int Modbus_Public_Var[128];		



/****************************************************************************
* 名	称:
* 功	能: 查表法计算crc
* 入口参数：
* 出口参数：
* 说	明：
****************************************************************************/
unsigned int crc16(unsigned char* puchMsg,unsigned char usDataLen)
{
unsigned char uchCRCHi = 0xFF ;
unsigned char uchCRCLo = 0xFF ;
unsigned int  uIndex ;

usDataLen = usDataLen-2;
	
while (usDataLen--)
{
	uIndex = uchCRCHi ^ (*puchMsg);
	uchCRCHi = uchCRCLo ^ auchCRCHi[uIndex] ;
	uchCRCLo = auchCRCLo[uIndex] ;
	puchMsg++;
}

return (((unsigned int)(uchCRCHi) << 8) | uchCRCLo);

}

/****************************************************************************
* 名	称:
* 功	能: 解析接收到的数据
* 入口参数：
* 出口参数：
* 说	明：
****************************************************************************/
void ParseRecieve(void)	 //包解析
{
  unsigned int calc_crc;
	unsigned int crc16tem;
	unsigned char i = 0; 
	unsigned int rw_adres;
	unsigned int rw_len;
	unsigned int portvalue;
		
	
	if (USARTStructure2.RX_BUFF[0] == SlaveID)  	// 从机ID是否正确
	{
    crc16tem=((unsigned int)(USARTStructure2.RX_BUFF[USARTStructure2.RX_Len-2] << 8) | USARTStructure2.RX_BUFF[USARTStructure2.RX_Len-1]); // calculate CRC check, erase two CRC byte
    calc_crc=crc16(&USARTStructure2.RX_BUFF[0],USARTStructure2.RX_Len);

    if (crc16tem==calc_crc)											// crc16检校正确
		{	 

			switch (USARTStructure2.RX_BUFF[1])				// 判断功能码
			{
				case 0x01:			//读取指定数量的线圈
									rw_adres = ((unsigned int)(USARTStructure2.RX_BUFF[2] << 8) | USARTStructure2.RX_BUFF[3]); 
									rw_len  = ((unsigned int)(USARTStructure2.RX_BUFF[4] << 8) | USARTStructure2.RX_BUFF[5]); 

									USART2_TX_BUFF[0] = SlaveID;
									USART2_TX_BUFF[1] = 0x01;
									USART2_TX_BUFF[2] = rw_len ;
									for( i = 0; i< USART2_TX_BUFF[2] ;i++)
									{
										portvalue =  (Modbus_Port[(rw_adres-MBPARTADRESS)/16] >> (rw_adres-MBPARTADRESS)%16);							
										USART2_TX_BUFF[i+3] = portvalue & 0x0001;					
									}		
									
									calc_crc=crc16(&USART2_TX_BUFF[0],USART2_TX_BUFF[2]+3);			//计算crc
									
									USART2_TX_BUFF[USART2_TX_BUFF[2]+3] = calc_crc >> 8 ;
									USART2_TX_BUFF[USART2_TX_BUFF[2]+4] = calc_crc;
									USART2_DMASendData(&USART2_TX_BUFF[0],USART2_TX_BUFF[2]+5);

					break;

				case 0x05:			//写入单个线圈				
									rw_adres = ((unsigned int)(USARTStructure2.RX_BUFF[2] << 8) | USARTStructure2.RX_BUFF[3]); 
									if(USARTStructure2.RX_BUFF[4] > 0 )
									{
										Modbus_Port[(rw_adres-MBPARTADRESS)/16] = (1<<(rw_adres-MBPARTADRESS)%16);
										
											  //控制输出函数
										for(i = 0;i< 8;i++)
										{
											USART2_TX_BUFF[i] = USARTStructure2.RX_BUFF[i];
										}
										USART2_DMASendData(&USART2_TX_BUFF[0],8);	
									}
					break;

				case 0x03:			//读取指定数量的寄存器
									rw_adres = ((unsigned int)(USARTStructure2.RX_BUFF[2] << 8) | USARTStructure2.RX_BUFF[3]); 		
									rw_len  = ((unsigned int)(USARTStructure2.RX_BUFF[4] << 8) | USARTStructure2.RX_BUFF[5]); 
									if (rw_adres >= MBPUBLICADRESS)
									{										
										USART2_TX_BUFF[0] = SlaveID;
										USART2_TX_BUFF[1] = 0x03;
										USART2_TX_BUFF[2] = rw_len *2;
										for( i = 0; i< USART2_TX_BUFF[2] ;i++)
										{
											USART2_TX_BUFF[i*2+3] = (Modbus_Public_Var[rw_adres -MBPUBLICADRESS + i]>>8);
											USART2_TX_BUFF[i*2+4] = Modbus_Public_Var[rw_adres -MBPUBLICADRESS + i];
										}							
										calc_crc=crc16(&USART2_TX_BUFF[0],USART2_TX_BUFF[2]+2);			//计算crc
										
										USART2_TX_BUFF[USART2_TX_BUFF[2]+3] = calc_crc >> 8 ;
										USART2_TX_BUFF[USART2_TX_BUFF[2]+4] = calc_crc;
										USART2_DMASendData(&USART2_TX_BUFF[0],USART2_TX_BUFF[2]+5);

									}
									else
									{
											USART2_TX_BUFF[0] = SlaveID ;
											USART2_TX_BUFF[1] = 0x07 ;
											USART2_TX_BUFF[2] = 0x02 ;
											calc_crc = crc16(&USART2_TX_BUFF[0],3);
											USART2_TX_BUFF[3] = calc_crc >> 8 ;
											USART2_TX_BUFF[4] = calc_crc;
											USART2_DMASendData(&USART2_TX_BUFF[0],5);
									}
		
					break;

				case 0x06:			//写单个的寄存器	
									rw_adres = ((unsigned int)(USARTStructure2.RX_BUFF[2] << 8) | USARTStructure2.RX_BUFF[3]); 
									if (rw_adres >= MBPUBLICADRESS)
									{										
											Modbus_Public_Var[rw_adres -MBPUBLICADRESS] = ((unsigned int)(USARTStructure2.RX_BUFF[4] << 8) | USARTStructure2.RX_BUFF[5]);
											
											for(i = 0;i< 8;i++)
											{
												USART2_TX_BUFF[i] = USARTStructure2.RX_BUFF[i];
											}
											USART2_DMASendData(&USART2_TX_BUFF[0],8);
									}
									else
									{
											USART2_TX_BUFF[0] = SlaveID ;
											USART2_TX_BUFF[1] = 0x07 ;
											USART2_TX_BUFF[2] = 0x02 ;
											calc_crc = crc16(&USART2_TX_BUFF[0],3);
											USART2_TX_BUFF[3] = calc_crc >> 8 ;
											USART2_TX_BUFF[4] = calc_crc;
											USART2_DMASendData(&USART2_TX_BUFF[0],5);
									}				
				
					break;
								

				
				case 0x10:			//写入指定数量的寄存器				
									rw_adres = ((unsigned int)(USARTStructure2.RX_BUFF[2] << 8) | USARTStructure2.RX_BUFF[3]); 
									rw_len  = ((unsigned int)(USARTStructure2.RX_BUFF[4] << 8) | USARTStructure2.RX_BUFF[5]); //6 单字节数量
									if (rw_adres >= 2000)
									{			
											for(i = 0;i< rw_len ;i++)
											{
												Modbus_Public_Var[rw_adres -MBPUBLICADRESS + i] = ((unsigned int)(USARTStructure2.RX_BUFF[i*2+7] << 8) | USARTStructure2.RX_BUFF[i*2+8]);
											}

											for(i = 0;i< 6 ;i++)
											{
												USART2_TX_BUFF[i] = USARTStructure2.RX_BUFF[i];
											}
											calc_crc = crc16(&USART2_TX_BUFF[0],6);
											USART2_TX_BUFF[6] = calc_crc >> 8 ;
											USART2_TX_BUFF[7] = calc_crc;
											USART2_DMASendData(&USART2_TX_BUFF[0],7);
									}
									else
									{
											USART2_TX_BUFF[0] = SlaveID ;
											USART2_TX_BUFF[1] = 0x07 ;
											USART2_TX_BUFF[2] = 0x02 ;
											calc_crc = crc16(&USART2_TX_BUFF[0],3);
											USART2_TX_BUFF[3] = calc_crc >> 8 ;
											USART2_TX_BUFF[4] = calc_crc;
											USART2_DMASendData(&USART2_TX_BUFF[0],5);
									}					
					break;
				
				default:
							USART2_TX_BUFF[0] = SlaveID ;
							USART2_TX_BUFF[1] = 0x07 ;
							USART2_TX_BUFF[2] = 0x01 ;
							calc_crc = crc16(&USART2_TX_BUFF[0],3);
							USART2_TX_BUFF[3] = calc_crc >> 8 ;
							USART2_TX_BUFF[4] = calc_crc;
							USART2_DMASendData(&USART2_TX_BUFF[0],5);
				break;
			}
			
		}
		else
		{
			USART2_TX_BUFF[0] = SlaveID ;
			USART2_TX_BUFF[1] = 0x07 ;
			USART2_TX_BUFF[2] = 0x03 ;
			calc_crc = crc16(&USART2_TX_BUFF[0],3);
			USART2_TX_BUFF[3] = calc_crc >> 8 ;
			USART2_TX_BUFF[4] = calc_crc;
			USART2_DMASendData(&USART2_TX_BUFF[0],5);
		}	
	}
}



